## build-plants/conf/bblayers.conf
```bitbake
# POKY_BBLAYERS_CONF_VERSION is increased each time build/conf/bblayers.conf
# changes incompatibly
POKY_BBLAYERS_CONF_VERSION = "2"

BBPATH = "${TOPDIR}"
BBFILES ?= ""

BBLAYERS ?= " \
  ${TOPDIR}/../poky/meta \
  ${TOPDIR}/../poky/meta-poky \
  ${TOPDIR}/../poky/meta-yocto-bsp \
  ${TOPDIR}/../meta-tegra \
  ${TOPDIR}/../meta-openembedded/meta-python \
  ${TOPDIR}/../meta-openembedded/meta-oe \
  ${TOPDIR}/../meta-openembedded/meta-networking \
  ${TOPDIR}/../meta-openembedded/meta-perl \
  ${TOPDIR}/../meta-python-mixin \
  ${TOPDIR}/../meta-security \
  ${TOPDIR}/../meta-clang \
  ${TOPDIR}/../meta-browser/meta-chromium \
  ${TOPDIR}/../meta-homeassistant \
  ${TOPDIR}/../meta-plants \
  "
```

## meta-plants/conf/layer.conf
```bitbake
# We have a conf and classes directory, add to BBPATH
BBPATH .= ":${LAYERDIR}"

# We have recipes-* directories, add to BBFILES
BBFILES += "${LAYERDIR}/recipes-*/*/*.bb \
            ${LAYERDIR}/recipes-*/*/*.bbappend"

BBFILE_COLLECTIONS += "meta-plants"
BBFILE_PATTERN_meta-plants = "^${LAYERDIR}/"
BBFILE_PRIORITY_meta-plants = "6"

LAYERDEPENDS_meta-plants = "core"
LAYERSERIES_COMPAT_meta-plants = "dunfell"
```
